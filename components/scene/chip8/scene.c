#include "chip8.h"
#include "canvas.h"
#include <stdint.h>
#include "freertos/FreeRTOS.h"
#include "freertos/task.h"

const char IBM_LOGO_ROM[132] = {
    0x00, 0xe0, 0xa2, 0x2a, 0x60, 0x0c, 0x61, 0x08, 0xd0, 0x1f, 0x70, 0x09,
    0xa2, 0x39, 0xd0, 0x1f, 0xa2, 0x48, 0x70, 0x08, 0xd0, 0x1f, 0x70, 0x04,
    0xa2, 0x57, 0xd0, 0x1f, 0x70, 0x08, 0xa2, 0x66, 0xd0, 0x1f, 0x70, 0x08,
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    0x00, 0x80, 0x00, 0x80, 0x00, 0x80, 0x00, 0x80, 0x00, 0xe0, 0x00, 0xe0};

static void chip8_task(void *arg)
{

    chip8_t *chip8 = new();
    load_rom(chip8, IBM_LOGO_ROM, 132);

    while (1)
    {

        for (int e = 0; e < 10; e++)
        {
            fetch_op(chip8);
            exec_op(chip8);
        }
        update_timers(chip8);

        canvas_pixel_t cpix[SCREEN_WIDTH * SCREEN_HEIGHT];
        for (int i = 0; i < SCREEN_WIDTH * SCREEN_HEIGHT; i++)
        {
            int x = i % SCREEN_WIDTH;
            int y = i / SCREEN_WIDTH;
            int color = chip8->screen[i];
            canvas_pixel_t pixel =
                {
                    .x = x,
                    .y = y,
                    .color = color,
                };

            cpix[i] = pixel;
        }
        canvas_draw_pixels(cpix, SCREEN_WIDTH * SCREEN_HEIGHT);
    }
    delete(chip8);
}

void chip8_init()
{
    xTaskCreate(chip8_task, "Chip8Task", 2 * 16384, NULL, 5, NULL);
}